## configs/smp615_uboot1st_defconfig
```kconfig
CONFIG_ARM=y
CONFIG_SKIP_LOWLEVEL_INIT=y
CONFIG_COUNTER_FREQUENCY=26000000
CONFIG_POSITION_INDEPENDENT=y
CONFIG_ARCH_EXYNOS=y
CONFIG_SYS_MALLOC_LEN=0x1000000
CONFIG_SYS_MALLOC_F_LEN=0x16000
CONFIG_TARGET_EXYNOS_MOBILE=y
CONFIG_ENV_SOURCE_FILE="smp615-uboot1st"
CONFIG_NR_DRAM_BANKS=3
CONFIG_DEFAULT_DEVICE_TREE="exynos9611-smp615-uboot1st"
CONFIG_SYS_LOAD_ADDR=0x80000000
CONFIG_DEBUG_UART_BASE=0x13820000
CONFIG_DEBUG_UART_CLOCK=26000000
CONFIG_ARMV8_CNTFRQ_BROKEN=y
# CONFIG_PSCI_RESET is not set
CONFIG_SYSRESET=y
CONFIG_SYSRESET_EXYNOS=y
CONFIG_SYSCON=y
CONFIG_CMD_RESET=y
CONFIG_DEBUG_UART=y
CONFIG_USE_PREBOOT=y
CONFIG_SYS_PBSIZE=1024
CONFIG_BOARD_TYPES=y
# CONFIG_DISPLAY_CPUINFO is not set
CONFIG_MISC_INIT_R=y
CONFIG_HUSH_PARSER=y
CONFIG_CMD_MEMINFO=y
CONFIG_CMD_CACHE=y
# CONFIG_CLK_EXYNOS7420 is not set
CONFIG_CLK_EXYNOS=y
CONFIG_CLK_EXYNOS9610=y
CONFIG_MISC=y
# CONFIG_MMC is not set
CONFIG_DEBUG_UART_ANNOUNCE=y
CONFIG_SOC_SAMSUNG=y
CONFIG_EXYNOS_PMU=y
CONFIG_VIDEO=y
# CONFIG_VIDEO_LOGO is not set
CONFIG_VIDEO_SIMPLE=y
```

## drivers/clk/exynos/Kconfig
```kconfig
config CLK_EXYNOS
	bool
	select CLK
	help
	  This enables support for common clock driver API on Samsung
	  Exynos SoCs.

menu "Clock drivers for Exynos SoCs"
	depends on CLK_EXYNOS

config CLK_EXYNOS7420
	bool "Clock driver for Samsung's Exynos7420 SoC"
	default y
	help
	  This enables common clock driver support for platforms based
	  on Samsung Exynos7420 SoC.

config CLK_EXYNOS7870
	bool "Clock driver for Samsung's Exynos7870 SoC"
	select CLK_CCF
	help
	  This enables common clock driver support for platforms based
	  on Samsung Exynos7870 SoC.

config CLK_EXYNOS850
	bool "Clock driver for Samsung's Exynos850 SoC"
	select CLK_CCF
	help
	  This enables common clock driver support for platforms based
	  on Samsung Exynos850 SoC.

config CLK_EXYNOS9610
	bool "Clock driver for Samsung's Exynos9610 SoC"
	select CLK_CCF
	help
	  Minimal CMU_TOP provider for Samsung Exynos9610-class parts
	  (e.g. SM-P615 / gta4xl) during uboot1st bring-up. Reports the
	  rates S-Boot leaves configured so DM-aware drivers can bind
	  without relying on fixed-clock stubs.

endmenu
```
